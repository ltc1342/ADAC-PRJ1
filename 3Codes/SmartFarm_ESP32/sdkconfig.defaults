## 3Codes/SmartFarm_ESP32/sdkconfig.defaults
```kconfig
# =============================================================
# sdkconfig.defaults – Smart Farm ESP32 Gateway
# Tuned for RAM and Flash efficiency on ESP-WROOM-32 (4 MB)
# =============================================================

# --- Wi-Fi buffers (reduce defaults to save ~10 KB RAM) ------
CONFIG_ESP_WIFI_STATIC_RX_BUFFER_NUM=4
CONFIG_ESP_WIFI_DYNAMIC_RX_BUFFER_NUM=8
CONFIG_ESP_WIFI_TX_BUFFER_TYPE_STATIC=y
CONFIG_ESP_WIFI_STATIC_TX_BUFFER_NUM=6

# --- MQTT buffer size ----------------------------------------
CONFIG_MQTT_BUFFER_SIZE=1024
CONFIG_MQTT_OUTBOX_EXPIRED_TIMEOUT_MS=30000

# --- HTTP Server ---------------------------------------------
CONFIG_HTTPD_MAX_REQ_HDR_LEN=1024
CONFIG_HTTPD_MAX_URI_LEN=512
CONFIG_HTTPD_MAX_OPEN_SOCKETS=4

# --- Logging: INFO in production; change to DEBUG to debug ---
CONFIG_LOG_DEFAULT_LEVEL_INFO=y
CONFIG_LOG_MAXIMUM_LEVEL_DEBUG=y

# --- FreeRTOS ------------------------------------------------
CONFIG_FREERTOS_HZ=1000
CONFIG_FREERTOS_USE_TICKLESS_IDLE=n

# --- System event task stack ---------------------------------
CONFIG_ESP_SYSTEM_EVENT_TASK_STACK_SIZE=4096

# --- Flash: enable compiler optimisations for size -----------
CONFIG_COMPILER_OPTIMIZATION_SIZE=y
CONFIG_COMPILER_OPTIMIZATION_ASSERTIONS_DISABLE=n

# --- Disable unused components to save Flash -----------------
CONFIG_ESP_ENABLE_COREDUMP=n
CONFIG_MBEDTLS_SSL_PROTO_TLS1=n
CONFIG_MBEDTLS_SSL_PROTO_TLS1_1=n
```
